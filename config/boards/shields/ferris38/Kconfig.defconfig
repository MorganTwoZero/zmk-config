## config/boards/shields/ferris38/Kconfig.defconfig
```kconfig
if SHIELD_FERRIS38_LEFT

config ZMK_KEYBOARD_NAME
    default "ferris38"

config ZMK_SPLIT_ROLE_CENTRAL
    default y

endif

if SHIELD_FERRIS38_LEFT || SHIELD_FERRIS38_RIGHT

config ZMK_SPLIT
    default y

endif
```

## config/boards/shields/ferris38/Kconfig.shield
```kconfig
config SHIELD_FERRIS38_LEFT
    def_bool $(shields_list_contains,ferris38_left)

config SHIELD_FERRIS38_RIGHT
    def_bool $(shields_list_contains,ferris38_right)
```
