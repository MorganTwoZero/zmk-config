## config/boards/shields/lets14x4/Kconfig.defconfig
```kconfig
if SHIELD_LETS14X4_LEFT

config ZMK_KEYBOARD_NAME
    default "lets14x4"

config ZMK_SPLIT_ROLE_CENTRAL
    default y

endif

if SHIELD_LETS14X4_LEFT || SHIELD_LETS14X4_RIGHT

config ZMK_SPLIT
    default y
```

## config/boards/shields/lets14x4/Kconfig.shield
```kconfig
config SHIELD_LETS14X4_LEFT
    def_bool $(shields_list_contains,lets14x4_left)

config SHIELD_LETS14X4_RIGHT
    def_bool $(shields_list_contains,lets14x4_right)
```
